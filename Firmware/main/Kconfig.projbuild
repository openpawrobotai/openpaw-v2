## Firmware/main/Kconfig.projbuild
```kconfig
menu "OpenPaw"

    config OPENPAW_WIFI_SSID
        string "Dev Wi-Fi SSID"
        default ""
        help
            Fallback station SSID used when no credentials are stored in NVS.
            For development only — production creds arrive via BLE provisioning.
            Leave blank to wait for provisioning instead.

    config OPENPAW_WIFI_PASS
        string "Dev Wi-Fi password"
        default ""
        help
            Password for the dev Wi-Fi SSID above.

    config OPENPAW_OTA_MANIFEST_URL
        string "OTA manifest URL"
        default "https://github.com/openpawrobotai/openpaw-v2/releases/latest/download/manifest.json"
        help
            HTTPS URL of the firmware manifest JSON ({"boards":{...}}). Defaults
            to the latest public GitHub release. Leave blank to disable OTA.

    config OPENPAW_OTA_CHECK_ON_BOOT
        bool "Check for OTA update on every boot"
        default n
        help
            When set, the device checks the manifest URL for a newer build each
            time Wi-Fi connects. Updates are normally triggered from the app.

endmenu
```

## Firmware/sdkconfig.defaults
```kconfig
# OpenPaw firmware defaults
CONFIG_PARTITION_TABLE_CUSTOM=y
CONFIG_PARTITION_TABLE_CUSTOM_FILENAME="partitions.csv"

# Flash size — XIAO ESP32-S3 has 8MB; partitions.csv (dual OTA + storage) needs >=4MB
CONFIG_ESPTOOLPY_FLASHSIZE_8MB=y

# PSRAM (octal) — required for the OV2640 camera frame buffers on the XIAO S3 Sense
CONFIG_SPIRAM=y
CONFIG_SPIRAM_MODE_OCT=y
CONFIG_SPIRAM_SPEED_80M=y
CONFIG_SPIRAM_BOOT_INIT=y
CONFIG_SPIRAM_USE_MALLOC=y
CONFIG_SPIRAM_MALLOC_RESERVE_INTERNAL=32768

# OTA rollback safety (app must self-validate or bootloader reverts)
CONFIG_BOOTLOADER_APP_ROLLBACK_ENABLE=y
CONFIG_APP_ROLLBACK_ENABLE=y

# Console + logs over native USB (XIAO ESP32-S3 has no UART bridge)
CONFIG_ESP_CONSOLE_USB_SERIAL_JTAG=y

# HTTPS OTA: validate the server certificate against the bundled root CA store
CONFIG_MBEDTLS_CERTIFICATE_BUNDLE=y
# Default OTA manifest — the latest public GitHub release (app triggers the check)
CONFIG_OPENPAW_OTA_MANIFEST_URL="https://github.com/openpawrobotai/openpaw-v2/releases/latest/download/manifest.json"

# BLE (NimBLE) for app pairing + Wi-Fi provisioning
CONFIG_BT_ENABLED=y
CONFIG_BT_NIMBLE_ENABLED=y

# FreeRTOS / logging
CONFIG_FREERTOS_HZ=1000
CONFIG_LOG_DEFAULT_LEVEL_INFO=y
```
